## boards/minshine/evmto61/Kconfig.evmto61
```kconfig
# Copyright (c) 2024, Charlie Palmer.
# SPDX-License-Identifier: Apache-2.0

config BOARD_EVMTO61
	select SOC_AT32F413CBT7
```

## soc/artery/at32/Kconfig.soc
```kconfig
# Copyright (c) 2024 Charlie Palmer
# SPDX-License-Identifier: Apache-2.0

config SOC_FAMILY_AT32
	bool

config SOC_FAMILY
	default "at32" if SOC_FAMILY_AT32

rsource "*/Kconfig.soc"
```

## soc/artery/at32/at32f413/Kconfig.soc
```kconfig
# Copyright (c) 2021, ATL Electronics
# SPDX-License-Identifier: Apache-2.0

config SOC_SERIES_AT32F413
	bool
	select SOC_FAMILY_AT32
	help
	  Enable support for Artery AT32F413 MCU series

config SOC_SERIES
	default "at32f413" if SOC_SERIES_AT32F413

config SOC_AT32F413CBT7
	bool
	select SOC_SERIES_AT32F413

config SOC
	default "at32f413cbt7" if SOC_AT32F413CBT7
```

## west.yml
```yaml
# Copyright (c) 2021 Nordic Semiconductor ASA
# Copyright (c) 2024 Charlie Palmer
# SPDX-License-Identifier: Apache-2.0

manifest:
  self:
    west-commands: scripts/west-commands.yml

  remotes:
    - name: zephyrproject-rtos
      url-base: https://github.com/zephyrproject-rtos

  projects:
    - name: zephyr
      description: zephyr RTOS
      remote: zephyrproject-rtos
      revision: main
      clone-depth: 1
      import:
        name-allowlist:
          - cmsis      # required by the ARM port
          - hal_stm32  # required by STM32 boards
```
